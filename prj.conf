## CMakeLists.txt
```
cmake_minimum_required(VERSION 3.20.0)

find_package(Zephyr REQUIRED HINTS $ENV{ZEPHYR_BASE})
project(lua_hello_world)

add_subdirectory(src)
```

## west.yml
```
manifest:
  remotes:
    - name: zephyrproject-rtos
      url-base: https://github.com/zephyrproject-rtos
    - name: lua
      url-base: https://github.com/tenllado/

  projects:
    - name: lua
      remote: lua
      repo-path: lua
      revision: zephyr
      path: modules/lib/lua
    - name: zephyr
      remote: zephyrproject-rtos
      repo-path: zephyr
      clone-depth: 1
      revision: main
      import: true
      path: zephyr

  self:
    path: app
```

## prj.conf
```kconfig
CONFIG_PRINTK=y
CONFIG_ASSERT=y
CONFIG_INIT_STACKS=y
CONFIG_MAIN_STACK_SIZE=4096
CONFIG_LOG=y
CONFIG_LOG_MODE_MINIMAL=y

# for lua
CONFIG_FILE_SYSTEM=y
# Choose between NEWLIB_LIBC or CONFIG_PICOLIBC
# Currently PICOLIBC only requires one missing stub and newlib three
# But requires the change of pull request https://github.com/zephyrproject-rtos/zephyr/pull/57832
CONFIG_NEWLIB_LIBC=y
#CONFIG_PICOLIBC=y
CONFIG_POSIX_API=y
CONFIG_LUA=y
```

## src/main.c
```c
#include <zephyr/kernel.h>
#include <zephyr/fs/fs.h>

#include <stdio.h>
#include <string.h>
#include <stdlib.h>
#include "lua.h"
#include "lauxlib.h"
#include "lualib.h"

int main(void)
{
	lua_State *L;

	printk("Starting lua code\n");
	L = luaL_newstate();
  	luaL_openlibs(L);
  	luaL_dostring(L, "print('Hello from Lua')");
	lua_close(L);
	printk("Test Done!\n");

	return 0;
}
```

## src/missing_stubs.c
```c
#include <zephyr/fs/fs.h>
#include <stdio.h>
#include <errno.h>
#include <sys/times.h>

/* FIXME: this stubs should be properly implemented, in zephyr itself or here.
 * This is just a temporal non-working implementation to start testing lua with
 * zephyr.
 */

clock_t _times(struct tms* tms)
{
	errno = ENOSYS;
	return (clock_t) -1;
}

int _unlink(const char *pathname)
{
	return fs_unlink(pathname);
}
```
